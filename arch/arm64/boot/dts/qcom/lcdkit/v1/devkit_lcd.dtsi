/*---------------------------------------------------------------------------
 * This file is autogenerated file using huawei LCD parser. Please do not edit it.
 * Update input XML file to add a new entry or update variable in this file
 * Parser location: vendor/huawei/chipset_common/devkit/lcdkit/tools 
 *---------------------------------------------------------------------------*/


#include "v1_auo_otm1911a_7p12_1080p_video.dtsi"
#include "v1_djn_ili9881c_5p99_720p_video.dtsi"
#include "v1_ebbg_hx8399c_7p12_1080p_video.dtsi"
#include "v1_hsd_hx8394f_5p99_720p_video.dtsi"
#include "v1_inx_ili9881c_5p99_720p_video.dtsi"