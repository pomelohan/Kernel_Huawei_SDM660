/ {
        huawei_wifi_info {
                  compatible = "huawei,hw_wifi_info";
                  status = "ok";
                  wifi,chiptype = "WIFI_QUALCOMM_WCN3980";
                  wifi,pubfile_id = "are_tl00";
                  wifi,fw_ver = "QCOM_WCN3980_2.0.2";
                  wifi,ini_type = "are_tl00";
        };
};

