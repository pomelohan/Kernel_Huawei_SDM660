/{
		huawei_fac_info {
		compatible = "huawei,hw_fac_info";
		fac,product_name = "ARE-L22";
		fac,hardware_ver = "HL1AREM";
		fac,software_ver = "ARE_L22_VA";
		fac,simcard_adapt = "support";
		status = "ok";
	};
};
