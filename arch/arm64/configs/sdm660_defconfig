## drivers/power/huawei/Kconfig
```kconfig
config HUAWEI_PMU_DSM
	bool "huawei dsm charger"
	depends on HUAWEI_DSM
config HUAWEI_BATT
	bool "huawei batt"
config HUAWEI_BATT2
	bool "huawei batt 2"
```

## drivers/staging/android/Kconfig
```kconfig
menu "Android"

if ANDROID
config HW_BINDER_FG_REQ_FIRST
	bool "Huawei Binder Proceed Foreground Request First"
	depends on ANDROID_BINDER_IPC && HW_VIP_THREAD
	default n
	---help---
	  Enable binder optimization of Huawei.

config ASHMEM
	bool "Enable the Anonymous Shared Memory Subsystem"
	default n
	depends on SHMEM
	---help---
	  The ashmem subsystem is a new shared memory allocator, similar to
	  POSIX SHM but with different behavior and sporting a simpler
	  file-based API.

	  It is, in theory, a good memory allocator for low-memory devices,
	  because it can discard shared memory units when under memory pressure.

config ANDROID_TIMED_OUTPUT
	bool "Timed output class driver"
	default y

config ANDROID_TIMED_GPIO
	tristate "Android timed gpio driver"
	depends on GPIOLIB || COMPILE_TEST
	depends on ANDROID_TIMED_OUTPUT
	default n
        ---help---
	  Unlike generic gpio is to allow programs to access and manipulate gpio
	  registers from user space, timed output/gpio is a system to allow changing
	  a gpio pin and restore it automatically after a specified timeout.

config ANDROID_LOW_MEMORY_KILLER
	bool "Android Low Memory Killer"
	---help---
	  Registers processes to be killed when low memory conditions, this is useful
	  as there is no particular swap space on android.

	  The registered process will kills according to the priorities in android init
	  scripts (/init.rc), and it defines priority values with minimum free memory size
	  for each priority.
config HUAWEI_LMK_DBG
	bool "HUAWEI Low Memory Killer debug"
	default n
	depends on ANDROID_LOW_MEMORY_KILLER
	---help---
	  print processes info when lmk happen per several seconds
config LOWMEM_DBG
	bool "Low Memory Killer debug"
	default n
	depends on HUAWEI_LMK_DBG
	---help---
	  print processes info when lmk happen per several seconds

config ANDROID_LOW_MEMORY_KILLER_AUTODETECT_OOM_ADJ_VALUES
	bool "Android Low Memory Killer: detect oom_adj values"
	depends on ANDROID_LOW_MEMORY_KILLER
	default y
	---help---
	  Detect oom_adj values written to
	  /sys/module/lowmemorykiller/parameters/adj and convert them
	  to oom_score_adj values.

config SYNC
	bool "Synchronization framework"
	default n
	select ANON_INODES
	select DMA_SHARED_BUFFER
	---help---
	  This option enables the framework for synchronization between multiple
	  drivers.  Sync implementations can take advantage of hardware
	  synchronization built into devices like GPUs.

config SW_SYNC
	bool "Software synchronization objects"
	default n
	depends on SYNC
	---help---
	  A sync object driver that uses a 32bit counter to coordinate
	  synchronization.  Useful when there is no hardware primitive backing
	  the synchronization.

config SW_SYNC_USER
	bool "Userspace API for SW_SYNC"
	default n
	depends on SW_SYNC
	---help---
	  Provides a user space API to the sw sync object.
	  *WARNING* improper use of this can result in deadlocking kernel
	  drivers from userspace.

config ONESHOT_SYNC
	bool "One shot sync objects"
	depends on SYNC
	help
	  This sync driver provides a way to create sync objects that may
	  be signaled by userspace. Unlike other sync objects, the
	  sync objects created by this driver may be signaled in any order
	  without changing the state of other sync objects on the timeline.

config ONESHOT_SYNC_USER
	bool "Userspace API for ONESHOT_SYNC"
	depends on SYNC
	help
	  Provide a userspace API for creating oneshot sync objects.

config HUAWEI_RCC
	tristate "RAM Compress and Clean"
	depends on SYSFS && SWAP
	default n
	help
	  Creates background thread for compress and clean used RAM
	  dynamiclly,enabled by write 1 to /sys/kernel/rcc/enable.

config HUAWEI_RCC_DEBUG
	bool "RAM Compress and Clean debug support"
	depends on HISI_RCC
	default n
	help
	  This option adds additional debugging code to the
	  RAM Compress and Clean module.

config HISI_SMART_RECLAIM
	bool "Enable smart reclaim"
	default y
	depends on PROCESS_RECLAIM
	help
	  When enabled, memory pages of background processes will be reclaimed.
	  Depending on if the process is an application or service.
	  In case of service, advise kernel to reclaim file backed pages
	  of background processes(file tpyes .dex, .jar and/or .apk).
	  This triggered by writting soft to /proc/<pid>/reclaim from user space.

source "drivers/staging/android/ion/Kconfig"

source "drivers/staging/android/fiq_debugger/Kconfig"

source "drivers/staging/android/hwlogger/Kconfig"

endif # if ANDROID

endmenu
```

## sound/soc/adsp_misc/Kconfig
```kconfig
config HUAWEI_SMARTPAKIT_AUDIO
	tristate "adsp_misc driver"
	default n
	help
		Say Y to enable adsp_misc driver support
```
