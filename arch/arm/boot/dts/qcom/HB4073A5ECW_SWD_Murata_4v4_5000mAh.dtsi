
qcom,HB4073A5ECW_SWD_Murata_4v4_5000mAh {
	/* #3497588_Huawei_Ares_Sunwoda_4900mAH_averaged_MasterSlave_Jul10th2018*/
	qcom,max-voltage-uv = <4400000>;
	qcom,nom-batt-capacity-mah = <5000>;
	qcom,fastchg-current-ma = <3000>;
	qcom,batt-id-kohm = <110>;
	qcom,battery-beta = <3435>;
	qcom,battery-type = "HB4073A5ECW_SWD_Murata_4v4_5000mAh";
	qcom,fg-cc-cv-threshold-mv = <4390>;
	qcom,checksum = <0x9393>;
	qcom,gui-version = "PM660GUI - 0.0.0.45";
	qcom,fg-profile-data = [
		 D7 1E 19 FD
		 3F 03 05 F5
		 71 1C B3 02
		 D7 0C 4E 0B
		 34 17 91 23
		 0A 45 65 53
		 6F 00 00 00
		 12 00 00 00
		 00 00 0F C5
		 36 C5 23 CB
		 1C 00 08 00
		 D7 CD E3 E5
		 55 FD C9 00
		 A9 F4 57 03
		 39 FD 0E 43
		 0F 06 09 20
		 27 00 14 00
		 91 1F D5 05
		 37 0A 9F 06
		 64 1C 8E 03
		 AB 15 6A 12
		 5F 18 10 23
		 4B 45 5D 53
		 6A 00 00 00
		 11 00 00 00
		 00 00 44 BC
		 3E CA 6E CD
		 19 00 00 00
		 41 EA E3 E5
		 A6 06 53 F3
		 A1 ED E1 03
		 6D EA BA 12
		 99 33 CC FF
		 07 10 00 00
		 E4 13 66 46
		 19 00 40 00
		 45 01 0A FA
		 FF 00 00 00
		 00 00 00 00
		 00 00 00 00
		 00 00 00 00
		 00 00 00 00
		 00 00 00 00
		 00 00 00 00
		 00 00 00 00
		 00 00 00 00
		 00 00 00 00
		 00 00 00 00
		 00 00 00 00
		 00 00 00 00
		 00 00 00 00
		 00 00 00 00
		 00 00 00 00
		 00 00 00 00
		 00 00 00 00
		 00 00 00 00
	];
};
