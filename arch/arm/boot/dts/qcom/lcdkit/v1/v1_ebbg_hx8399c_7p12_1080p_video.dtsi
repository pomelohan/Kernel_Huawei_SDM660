/* Copyright (c) 2013, The Linux Foundation. All rights reserved.
 *
 * This program is free software; you can redistribute it and/or modify
 * it under the terms of the GNU General Public License version 2 and
 * only version 2 as published by the Free Software Foundation.
 *
 * This program is distributed in the hope that it will be useful,
 * but WITHOUT ANY WARRANTY; without even the implied warranty of
 * MERCHANTABILITY or FITNESS FOR A PARTICULAR PURPOSE.  See the
 * GNU General Public License for more details.
 */

/*-------------------------------------------------------------------------
 * This file is autogenerated file using gcdb parser. Please do not edit it.
 * Update input XML file to add a new entry or update variable in this file
 * VERSION = 1.1
 *-----------------------------------------------------------------------*/
/ {
	dsi_v1_ebbg_hx8399c_7p12_1080p_video: lcdkit_v1_ebbg_hx8399c_7p12_1080p_video {
		compatible = "ebbg_hx8399c_7p12_1080p_video";
		hw,lcdkit-panel-name = "EBBG_HX8399C 7P12 VIDEO TFT 1080 x 2244";
		hw,lcdkit-panel-type = <1>;
		hw,lcdkit-panel-xres = <1080>;
		hw,lcdkit-panel-yres = <2244>;
		hw,lcdkit-panel-width = <78>;
		hw,lcdkit-panel-height = <162>;
		hw,lcdkit-panel-on-command = [05 01 00 00 64 00 02 11 00
					 05 01 00 00 00 00 02 29 00];
		hw,lcdkit-panel-on-command-state = "dsi_lp_mode";
		hw,lcdkit-panel-display-on-command = [05 01 00 00 64 00 02 29 00];
		hw,lcdkit-panel-off-command = [05 01 00 00 14 00 02 28 00
			05 01 00 00 78 00 02 10 00];
		hw,lcdkit-panel-off-command-state = "dsi_lp_mode";
		hw,lcdkit-panel-backlight-command = [39 01 00 00 00 00 03 51 00 00];
		hw,lcdkit-panel-backlight-command-state = "dsi_lp_mode";
		hw,lcdkit-panel-cabc-off-command = [15 01 00 00 00 00 02 55 00];
		hw,lcdkit-panel-cabc-off-command-state = "dsi_lp_mode";
		hw,lcdkit-panel-cabc-ui-command = [15 01 00 00 00 00 02 55 01
			15 01 00 00 00 00 02 53 24];
		hw,lcdkit-panel-cabc-ui-command-state = "dsi_lp_mode";
		hw,lcdkit-panel-cabc-still-command = [15 01 00 00 00 00 02 55 02
			15 01 00 00 00 00 02 53 2C];
		hw,lcdkit-panel-cabc-still-command-state = "dsi_lp_mode";
		hw,lcdkit-panel-cabc-moving-command = [15 01 00 00 00 00 02 55 03
			15 01 00 00 00 00 02 53 2C];
		hw,lcdkit-panel-cabc-moving-command-state = "dsi_lp_mode";
		hw,lcdkit-panel-cabc-support = <0>;
		hw,lcdkit-panel-display-on-effect-command = [15 01 00 00 00 00 02 55 81];
		hw,lcdkit-panel-dot-inversion-command = [39 01 00 00 00 00 02 b2 42];
		hw,lcdkit-panel-dot-inversion-command-state = "dsi_lp_mode";
		hw,lcdkit-panel-column-inversion-command = [39 01 00 00 00 00 02 b2 40];
		hw,lcdkit-panel-column-inversion-command-state = "dsi_lp_mode";
		hw,lcdkit-panel-inversion-support = <0>;
		hw,lcdkit-panel-forword-scan-command = [39 01 00 00 00 00 02 cc 08];
		hw,lcdkit-panel-forword-scan-command-state = "dsi_lp_mode";
		hw,lcdkit-panel-revert-scan-command = [39 01 00 00 00 00 02 cc 04];
		hw,lcdkit-panel-revert-scan-command-state = "dsi_lp_mode";
		hw,lcdkit-panel-scan-support = <0>;
		hw,lcdkit-panel-display-region-support = <0>;
		hw,lcdkit-panel-checksum-support = <0>;
		hw,lcdkit-panel-esd-reg-command = [14 01 00 00 00 00 01 0a
						 14 01 00 00 00 00 01 45
						 14 01 00 00 00 00 01 0b
						 14 01 00 00 00 00 01 0d];
		hw,lcdkit-panel-esd-reg-command-state = "dsi_lp_mode";
		hw,lcdkit-panel-esd-value = [9d 08 00 00];
		hw,lcdkit-panel-esd-support = <1>;
		hw,lcdkit-panel-check-reg-command = [06 01 00 00 00 00 01 0a];
		hw,lcdkit-panel-check-reg-value = [9d];
		hw,lcdkit-panel-check-reg-command-state = "dsi_lp_mode";
		hw,lcdkit-panel-check-reg-support = <0>;
		hw,lcdkit-panel-check-on-value = [0a];
		hw,lcdkit-panel-check-reg-expect-value = [9d];
		hw,lcdkit-panel-check-reg-mask-value = [ff];
		hw,lcdkit-panel-bl-maxnit-command = [14 01 00 00 00 00 01 da];
		hw,lcdkit-panel-bl-maxnit-command-state = "dsi_lp_mode";
		hw,lcdkit-panel-mipi-detect-support = <0>;
		hw,lcdkit-panel-shutdown-sleep-support = <0>;
		hw,lcdkit-dsi-bpp = <24>;
		hw,lcdkit-panel-cmd-type = <0>;
		hw,lcdkit-pixel-packing = <0>;
		hw,lcdkit-underflow-color = <0x00>;
		hw,lcdkit-border-color = <0>;
		hw,lcdkit-panel-orientation = <0>;
		hw,lcdkit-brightness-max-level = <4095>;
		hw,lcdkit-bl-min-level = <15>;
		hw,lcdkit-bl-max-level = <4095>;
		hw,lcdkit-interleave-mode = <0>;
		hw,lcdkit-down-reset-enable;
		hw,lcdkit-te-using-te-pin;
		hw,lcdkit-h-sync-pulse = <1>;
		hw,lcdkit-bllp-power-mode;
		hw,lcdkit-bllp-eof-power-mode;
		hw,lcdkit-traffic-mode = "burst_mode";
		hw,lcdkit-te-dcs-command = <1>;
		hw,lcdkit-te-pin-select = <1>;
		hw,lcdkit-virtual-channel-id = <0>;
		hw,lcdkit-color-order = "rgb_swap_rgb";
		hw,lcdkit-lane-0-state;
		hw,lcdkit-lane-1-state;
		hw,lcdkit-lane-2-state;
		hw,lcdkit-lane-3-state;
		hw,lcdkit-h-left-border = <0>;
		hw,lcdkit-h-right-border = <0>;
		hw,lcdkit-v-top-border = <0>;
		hw,lcdkit-v-bottom-border = <0>;
		hw,lcdkit-panel-framerate = <60>;
		hw,lcdkit-panel-timings = [e6 38 26 00 68 6e 2a 3c 44 03 04 00];
		hw,lcdkit-panel-timings-phy-v2 = [25 20 09 0A 06 03 04 a0
						 25 20 09 0A 06 03 04 a0
						 25 20 09 0A 06 03 04 a0
						 25 20 09 0A 06 03 04 a0
						 25 1F 09 0A 06 03 04 a0];
		hw,lcdkit-t-clk-pre = <0x36>;
		hw,lcdkit-t-clk-post = <0x0E>;
		hw,lcdkit-tx-eot-append;
		hw,lcdkit-stream = <0>;
		hw,lcdkit-lp11-init;
		hw,lcdkit-mdp-trigger = "none";
		hw,lcdkit-dma-trigger = "trigger_sw";
		hw,lcdkit-bl-pmic-control-type = "bl_ctrl_wled";
		qcom,panel-supply-entries = <&dsi_panel_pwr_supply>;
		hw,lcdkit-lane-map = "lane_map_0123";
		hw,lcdkit-delay-before-bl = <0>;
		hw,lcdkit-mipi-regulator-mode = <1>;
		hw,lcdkit-bl-en-gpio = <0>;
		hw,lcdkit-delay-af-rst-off = <20>;
		hw,lcdkit-delay-af-blic-init = <0>;
		hw,lcdkit-bl-level-limit-percent = <100>;
		hw,lcdkit-use-second-ic-for-esd = <0>;
		hw,lcdkit-esd-check-num = <3>;
		hw,lcdkit-tp-reset-gpio = <0>;
		hw,lcdkit-panel-bl-maxnit = <470>;
		hw,lcdkit-panel-getblmaxnit-type = <0>;
		hw,lcdkit-h-back-porch = <80>;
		hw,lcdkit-h-front-porch = <76>;
		hw,lcdkit-h-pulse-width = <20>;
		hw,lcdkit-v-back-porch = <10>;
		hw,lcdkit-v-pulse-width = <10>;
		hw,lcdkit-v-front-porch = <10>;
		hw,lcdkit-h-sync-skew = <0>;
		hw,lcdkit-lcd-type = <0>;
		hw,lcdkit-panel-pt-test-support = <1>;
		hw,lcdkit-bias-power-ctrl-mode = <0x01>;
		hw,lcdkit-iovcc-power-ctrl-mode = <0x01>;
		hw,lcdkit-vci-power-ctrl-mode = <0x01>;
		hw,lcdkit-id0-gpio = <55>;
		hw,lcdkit-id1-gpio = <56>;
		hw,lcdkit-reset-gpio = <53>;
		hw,lcdkit-te-gpio = <0>;
		hw,lcdkit-vsp-gpio = <0>;
		hw,lcdkit-vsn-gpio = <0>;
		hw,lcdkit-iovcc-gpio = <0>;
		hw,lcdkit-vci-gpio = <0>;
		hw,lcdkit-bl-gpio = <0>;
		hw,lcdkit-iovcc-on-is-need-reset = <0>;
		hw,lcdkit-vsn-on-is-need-reset = <0>;
		hw,lcdkit-lcd-vsp = <5500000>;
		hw,lcdkit-lcd-vsn = <5500000>;
		hw,lcdkit-lcd-rst-first-high = <1>;
		hw,lcdkit-lcd-rst-low = <7>;
		hw,lcdkit-lcd-rst-second-high = <7>;
		hw,lcdkit-delay-af-vci-on = <0>;
		hw,lcdkit-delay-af-iovcc-on = <10>;
		hw,lcdkit-delay-af-bias-on = <0>;
		hw,lcdkit-delay-af-vsp-on = <3>;
		hw,lcdkit-delay-af-vsn-on = <6>;
		hw,lcdkit-delay-af-lp11 = <0>;
		hw,lcdkit-delay-af-tp-reset = <25>;
		hw,lcdkit-delay-af-vsn-off = <3>;
		hw,lcdkit-delay-af-vsp-off = <5>;
		hw,lcdkit-delay-af-bias-off = <0>;
		hw,lcdkit-delay-af-iovcc-off = <0>;
		hw,lcdkit-delay-af-vci-off = <0>;
		hw,lcdkit-panel-off-reset-high = <0>;
		hw,lcdkit-dsi-min-refresh-rate = <60>;
		hw,lcdkit-dsi-max-refresh-rate = <60>;
		hw,lcdkit-dsi-pan-enable-dynamic-fps;
		hw,lcdkit-dsi-pan-fps-update = "dfps_immediate_porch_mode_vfp";
    };
};